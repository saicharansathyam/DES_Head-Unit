## yocto/layers/meta-headunit/conf/layer.conf
```bitbake
# We have a conf and classes directory, add to BBPATH
BBPATH .= ":${LAYERDIR}"

# We have recipes-* directories, add to BBFILES
BBFILES += "${LAYERDIR}/recipes-*/*/*.bb \
            ${LAYERDIR}/recipes-*/*/*.bbappend"

BBFILE_COLLECTIONS += "meta-headunit"
BBFILE_PATTERN_meta-headunit = "^${LAYERDIR}/"
BBFILE_PRIORITY_meta-headunit = "10"

LAYERDEPENDS_meta-headunit = "core qt6-layer"
LAYERSERIES_COMPAT_meta-headunit = "scarthgap"

# Preferred versions
PREFERRED_VERSION_qtbase = "6.7%"
PREFERRED_VERSION_qtdeclarative = "6.7%"

# Global variables
HEADUNIT_VERSION = "1.0.0"
HEADUNIT_CONFIG_DIR = "${sysconfdir}/headunit"
HEADUNIT_DATA_DIR = "${datadir}/headunit"
HEADUNIT_LOG_DIR = "${localstatedir}/log/headunit"
```
